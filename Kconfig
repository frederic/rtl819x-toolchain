## linux-2.6.30/drivers/net/wireless/rtl8192e/Kconfig
```kconfig
#
# Wireless LAN device configuration
#
config RTL8192E
	tristate "RTL8192E, RTL8881A support"

config WLAN_HAL_8192EE
        bool "Realtek 8192E wireless support"
	select WLAN_HAL
	select WLAN_HAL_88XX
	depends on RTL8192E	
        default n    

config RTL8190_PRIV_SKB
        bool "Private skb buffer management"
        depends on RTL8192E
        default y

config RTL_VAP_SUPPORT
        bool "Virtual AP Support"
        depends on RTL8192E
        default y

config RTL_CLIENT_MODE_SUPPORT
        bool "Client Mode Support"
        depends on RTL8192E
        default y

config RTL_REPEATER_MODE_SUPPORT
	bool "Repeater Mode support"
	depends on RTL8192E && RTL_CLIENT_MODE_SUPPORT
	default y

config RTL_802_1X_CLIENT_SUPPORT
	bool "Client Mode 802.1x Support"
	depends on RTL8192E && RTL_CLIENT_MODE_SUPPORT
	default n

config RTL_SUPPORT_MULTI_PROFILE
	bool "Multiple AP profile Support"
	depends on RTL8192E && RTL_CLIENT_MODE_SUPPORT
	default y

config RTL_WDS_SUPPORT
        bool "WDS Support"
        depends on RTL8192E
        default y

config PHY_EAT_40MHZ
	bool "Clock Source, Select is 40MHz, otherwise 25MHz"
	depends on RTL8192E && !AUTO_PCIE_PHY_SCAN
	default y

#
# Hidden options
#


config RTL_ODM_WLAN_DRIVER
	bool 
	
config WLAN_HAL
        bool 
        select RTL_ODM_WLAN_DRIVER if WLAN_HAL

config WLAN_HAL_88XX
        bool 
        depends on WLAN_HAL
        
```

## linux-2.6.30/drivers/serial/Kconfig
```kconfig
#
# Serial device configuration
#
# $Id: Kconfig,v 1.11 2004/03/11 18:08:04 lethal Exp $
#

menu "Serial drivers"

#
# The new 8250/16550 serial drivers
config SERIAL_8250
	tristate "8250/16550 and compatible serial support"
	select SERIAL_CORE
	---help---
	  This selects whether you want to include the driver for the standard
	  serial ports.  The standard answer is Y.  People who might say N
	  here are those that are setting up dedicated Ethernet WWW/FTP
	  servers, or users that have one of the various bus mice instead of a
	  serial mouse and don't intend to use their machine's standard serial
	  port for anything.  (Note that the Cyclades and Stallion multi
	  serial port drivers do not need this driver built in for them to
	  work.)

	  To compile this driver as a module, choose M here: the
	  module will be called 8250.
	  [WARNING: Do not compile this driver as a module if you are using
	  non-standard serial ports, since the configuration information will
	  be lost when the driver is unloaded.  This limitation may be lifted
	  in the future.]

	  BTW1: If you have a mouseman serial mouse which is not recognized by
	  the X window system, try running gpm first.

	  BTW2: If you intend to use a software modem (also called Winmodem)
	  under Linux, forget it.  These modems are crippled and require
	  proprietary drivers which are only available under Windows.

	  Most people will say Y or M here, so that they can use serial mice,
	  modems and similar devices connecting to the standard serial ports.

config SERIAL_8250_CONSOLE
	bool "Console on 8250/16550 and compatible serial port"
	depends on SERIAL_8250=y
	select SERIAL_CORE_CONSOLE
	---help---
	  If you say Y here, it will be possible to use a serial port as the
	  system console (the system console is the device which receives all
	  kernel messages and warnings and which allows logins in single user
	  mode). This could be useful if some terminal or printer is connected
	  to that serial port.

	  Even if you say Y here, the currently visible virtual console
	  (/dev/tty0) will still be used as the system console by default, but
	  you can alter that using a kernel command line option such as
	  "console=ttyS1". (Try "man bootparam" or see the documentation of
	  your boot loader (grub or lilo or loadlin) about how to pass options
	  to the kernel at boot time.)

	  If you don't have a VGA card installed and you say Y here, the
	  kernel will automatically use the first serial line, /dev/ttyS0, as
	  system console.

	  If unsure, say N.

config SERIAL_8250_NR_UARTS
	int "Maximum number of 8250/16550 serial ports"
	depends on SERIAL_8250
	default "4"
	help
	  Set this to the number of serial ports you want the driver
	  to support.  This includes any ports discovered via ACPI or
	  PCI enumeration and any ports that may be added at run-time
	  via hot-plug, or any ISA multi-port serial cards.

config SERIAL_8250_RUNTIME_UARTS
	int "Number of 8250/16550 serial ports to register at runtime"
	depends on SERIAL_8250
	range 0 SERIAL_8250_NR_UARTS
	default "4"
	help
	  Set this to the maximum number of serial ports you want
	  the kernel to register at boot time.  This can be overridden
	  with the module parameter "nr_uarts", or boot-time parameter
	  8250.nr_uarts

config SERIAL_8250_EXTENDED
	bool "Extended 8250/16550 serial driver options"
	depends on SERIAL_8250
	help
	  If you wish to use any non-standard features of the standard "dumb"
	  driver, say Y here. This includes HUB6 support, shared serial
	  interrupts, special multiport support, support for more than the
	  four COM 1/2/3/4 boards, etc.

	  Note that the answer to this question won't directly affect the
	  kernel: saying N will just cause the configurator to skip all
	  the questions about serial driver options. If unsure, say N.

config SERIAL_8250_MANY_PORTS
	bool "Support more than 4 legacy serial ports"
	depends on SERIAL_8250_EXTENDED && !IA64
	help
	  Say Y here if you have dumb serial boards other than the four
	  standard COM 1/2/3/4 ports. This may happen if you have an AST
	  FourPort, Accent Async, Boca (read the Boca mini-HOWTO, available
	  from <http://www.tldp.org/docs.html#howto>), or other custom
	  serial port hardware which acts similar to standard serial port
	  hardware. If you only use the standard COM 1/2/3/4 ports, you can
	  say N here to save some memory. You can also say Y if you have an
	  "intelligent" multiport card such as Cyclades, Digiboards, etc.

config SERIAL_8250_SHARE_IRQ
	bool "Support for sharing serial interrupts"
	depends on SERIAL_8250_EXTENDED
	help
	  Some serial boards have hardware support which allows multiple dumb
	  serial ports on the same board to share a single IRQ. To enable
	  support for this in the serial driver, say Y here.

config SERIAL_CORE
	tristate

config SERIAL_CORE_CONSOLE
	bool

comment "8250 compatible port support"
config SERIAL_RTL8198_UART1
	bool "8198 UART1 support"
	depends on SERIAL_8250 && SERIAL_8250_NR_UARTS >= 2 && SERIAL_8250_RUNTIME_UARTS >= 2
	help
		Enable 8198 UART1 support, and this MAY add an uart device to ttyS1. 
		NOTE: We don't provide option for this port to be console. 

config SERIAL_SC16IS7X0
	bool "SC16IS7x0 series (I2C bus) support"
	depends on SERIAL_8250 && SERIAL_8250_NR_UARTS >= 2 && SERIAL_8250_RUNTIME_UARTS >= 2
	help
		Enable sc16is7x0 definition is to add an UART device to ttyS1. 
		This is based on standard 8250, and doesn't affect original setting. 
choice
	prompt "Crystal for SC16IS7x0 XTAL1"
	depends on SERIAL_SC16IS7X0
	help 
		Crystal for SC16IS7x0 XTAL1. 
		This is factor of baudrate, so bad parameter will cause UART to be 
		abnormal.
	config SERIAL_SC16IS7X0_XTAL1_CLK_1843200
		bool "1.8432 MHZ"
	config SERIAL_SC16IS7X0_XTAL1_CLK_14746500
		bool "14.7465 MHZ (NXP demoboard)"
endchoice
config SERIAL_SC16IS7X0_CONSOLE
	bool "Console on SC16IS7x0 port (ttyS1)"
	depends on SERIAL_SC16IS7X0 && SERIAL_8250_CONSOLE
	help
		If you don't check this option, we will use standard 8250 as console.
		Here, 8250 and sc16is7x0 occups ttyS0 and ttyS1 respectively.
		Notice 1:
			You need add "console=ttyS1" to CONFIG_CMDLINE, or console output will be incorrect.  
		Notice 2: 
			If you want to make user space's stdout to this port, 
			device (major,minor) of /dev/console has to be ttyS1 (4,65) 
			instead of ttyS0 (4,64). 
endmenu
```

## linux-2.6.30/drivers/staging/rtk_uWiFi/Kconfig
```kconfig
config USB_UWIFI_HOST
	tristate "RTK USB uWiFi host driver"
	default N
	---help---
	 This enables the RTK uWiFi device driver which will run on the
	 host machine.



config RTL_USB_UWIFI_HOST_SPEEDUP
	bool 
	depends on USB_UWIFI_HOST
	default y if USB_UWIFI_HOST
	
```

## linux-2.6.30/net/rtl/fastpath/Kconfig
```kconfig
menu "Custom: Netfilter Configuration"
 
config BASEON_SCHEDULE_FILTER
        tristate "Ethernet URL filter baseon Schedule tables  support"
        help
           enable Url baseon schedule table filter
endmenu
```
