/*
 * Automatically generated C config: don't edit
 * Linux kernel version: 2.6.30.9
 * Fri Oct  5 16:24:36 2012
 */
/*
 * DO NOT MODIFY.
 *
 * This file was generated by Kbuild
 *
 */

/* MIPS pt_regs offsets. */
/* MIPS task_struct offsets. */







/* MIPS thread_info offsets. */
/* MIPS specific thread_struct offsets. */
/* Size of struct page */


/* Linux mm_struct offsets. */
/* Linux sigcontext offsets. */





/* Linux signal numbers. */
/* Linux irq_cpustat_t offsets. */
/* Align . to a 8 byte boundary equals to maximum function alignment. */


/* The actual configuration determine if the init/exit sections
 * are handled as text/data or they can be discarded (which
 * often happens at runtime)
 */
/* .data section */
/* RODATA provided for backward compatibility.
 * All archs are supposed to use RO_DATA() */
/* .text section. Map to function alignment to avoid address changes
 * during second ld run in second ld pass when generating System.map */
/* sched.text is aling to function alignment to secure we have same
 * address even at second ld pass when generating System.map */






/* spinlock.text is aling to function alignment to secure we have same
 * address even at second ld pass when generating System.map */
/* Section used for early init (in .S files) */


/* init and exit section handling */
  /* DWARF debug sections.
		Symbols in the DWARF debugging sections are relative to
		the beginning of the section so we begin them at 0.  */
  /* Stabs debugging sections.  */
/**
 * PERCPU_VADDR - define output section for percpu area
 * @vaddr: explicit base address (optional)
 * @phdr: destination PHDR (optional)
 *
 * Macro which expands to output section for percpu area.  If @vaddr
 * is not blank, it specifies explicit base address and all percpu
 * symbols will be offset from the given address.  If blank, @vaddr
 * always equals @laddr + LOAD_OFFSET.
 *
 * @phdr defines the output PHDR to use if not blank.  Be warned that
 * output PHDR is sticky.  If @phdr is specified, the next output
 * section in the linker script will go there too.  @phdr should have
 * a leading colon.
 *
 * Note that this macros defines __per_cpu_load as an absolute symbol.
 * If there is no need to put the percpu section at a predetermined
 * address, use PERCPU().
 */
/**
 * PERCPU - define output section for percpu area, simple version
 * @align: required alignment
 *
 * Align to @align and outputs output section for percpu area.  This
 * macro doesn't maniuplate @vaddr or @phdr and __per_cpu_load and
 * __per_cpu_start will be identical.
 *
 * This macro is equivalent to ALIGN(align); PERCPU_VADDR( , ) except
 * that __per_cpu_load is defined as a relative symbol against
 * .data.percpu which is required for relocatable x86_32
 * configuration.
 */
OUTPUT_ARCH(mips)
ENTRY(kernel_entry)
PHDRS {
 text PT_LOAD FLAGS(7); /* RWX */
 note PT_NOTE FLAGS(4); /* R__ */
}
jiffies = jiffies_64 + 4;

SECTIONS
{
 . = 0x80000000;
 /* read-only */
 _text = .; /* Text and read-only data */
 .text : {
  . = ALIGN(8); *(.text.hot) *(.text) *(.ref.text) *(.text.unlikely)
  . = ALIGN(8); __sched_text_start = .; *(.sched.text) __sched_text_end = .;
  . = ALIGN(8); __lock_text_start = .; *(.spinlock.text) __lock_text_end = .;
  . = ALIGN(8); __kprobes_text_start = .; *(.kprobes.text) __kprobes_text_end = .;
  *(.text.*)
  *(.fixup)
  *(.gnu.warning)
/*#ifdef CONFIG_RTL8192SE*/

  /* start of wlan f/w definition */
  __fw_start = . ;
  *(.rtl8192sfw.bin)
  __fw_end = . ;

  __AGC_TAB_start = . ;
  *(.AGC_TAB.txt)
  __AGC_TAB_end = . ;

  __phy_reg_start = . ;
  *(.phy_reg.txt)
  __phy_reg_end = . ;

  __phy_reg_MP_start = . ;
  *(.phy_reg_MP.txt)
  __phy_reg_MP_end = . ;

  __MACPHY_REG_start = . ;
  *(.MACPHY_REG.txt)
  __MACPHY_REG_end = . ;

  __radio_a_start = . ;
  *(.radio_a.txt)
  __radio_a_end = . ;

  __radio_b_start = . ;
  *(.radio_b.txt)
  __radio_b_end = . ;

  __PHY_REG_PG_start = .;
  *(.PHY_REG_PG.txt)
  __PHY_REG_PG_end = .;

  __PHY_to1T2R_start = .;
  *(.PHY_to1T2R.txt)
  __PHY_to1T2R_end = .;

  __PHY_to1T2R_b_start = .;
  *(.PHY_to1T2R_b.txt)
  __PHY_to1T2R_b_end = .;

  __PHY_to1T1R_start = .;
  *(.PHY_to1T1R.txt)
  __PHY_to1T1R_end = .;

  __PHY_to1T1R_b_start = .;
  *(.PHY_to1T1R_b.txt)
  __PHY_to1T1R_b_end = .;

  __radio_a_hp_start = . ;
  *(.radio_a_hp.txt)
  __radio_a_hp_end = . ;

  /* end of wlan f/w definition */


 } :text = 0
 _etext = .; /* End of text section */

 /* Exception table */
 . = ALIGN(16);
 __ex_table : {
  __start___ex_table = .;
  *(__ex_table)
  __stop___ex_table = .;
 }

 /* Exception table for data bus errors */
 __dbe_table : {
  __start___dbe_table = .;
  *(__dbe_table)
  __stop___dbe_table = .;
 }
 /* jasonwang0413*/
    . = ALIGN(8192*4);
    __iram = . ;
    .iram :
    {
  *(.iram-gen) /* general usage (essential) */
  *(.iram-fwd) /* general packet forwarding used */
  *(.iram-rtkwlan) /* realtek wlan driver */
  *(.iram-l2-fwd) /* L2 packet forwarding */
  *(.iram-l34-fwd) /* L34 packet forwarding */
  *(.iram-tx) /* protocol stack TX */
  *(.iram-extdev) /* ROMEDRV extension device fwd */
  *(.iram-crypto) /* authetication / crypto-engine */
  *(.iram-rtkusb) /* usb */
  *(.iram-voip) /* voip */
  *(.iram) /* other usage */
  *(.iram.1)
  __iram_end = .; /* help programmer know the iram size */
    }



    . = ALIGN(8192);
    __dram = . ;
    __dram_start = . ;
    .dram :
    {
  *(.dram-wapi) /*wapi encryption/decryption used*/
     *(.dram-gen) /* general usage (essential) */
  *(.dram-fwd) /* general packet forwarding used */
     *(.dram-l2-fwd) /* L2 packet forwarding */
  *(.dram-l34-fwd) /* L34 packet forwarding */
     *(.dram-extdev) /* ROMEDRV extension device fwd */
     *(.dram-rtkwlan) /* realtek wlan driver */
  *(.dram-crypto) /* authetication / crypto-engine */
     *(.dram-voip) /* voip */
  *(.dram-tx) /* protocol stack TX */
  *(.dram) /* other usage */
  *(.dram.1)
    }
    . = ALIGN(8192);



    __dram_end = . ;

 .notes : AT(ADDR(.notes) - 0) { __start_notes = .; *(.note.*) __stop_notes = .; } :text :note
 .dummy : { *(.dummy) } :text

 . = ALIGN((4096)); .rodata : AT(ADDR(.rodata) - 0) { __start_rodata = .; *(.rodata) *(.rodata.*) *(__vermagic) *(__markers_strings) *(__tracepoints_strings) } .rodata1 : AT(ADDR(.rodata1) - 0) { *(.rodata1) } .pci_fixup : AT(ADDR(.pci_fixup) - 0) { __start_pci_fixups_early = .; *(.pci_fixup_early) __end_pci_fixups_early = .; __start_pci_fixups_header = .; *(.pci_fixup_header) __end_pci_fixups_header = .; __start_pci_fixups_final = .; *(.pci_fixup_final) __end_pci_fixups_final = .; __start_pci_fixups_enable = .; *(.pci_fixup_enable) __end_pci_fixups_enable = .; __start_pci_fixups_resume = .; *(.pci_fixup_resume) __end_pci_fixups_resume = .; __start_pci_fixups_resume_early = .; *(.pci_fixup_resume_early) __end_pci_fixups_resume_early = .; __start_pci_fixups_suspend = .; *(.pci_fixup_suspend) __end_pci_fixups_suspend = .; } .builtin_fw : AT(ADDR(.builtin_fw) - 0) { __start_builtin_fw = .; *(.builtin_fw) __end_builtin_fw = .; } .rio_route : AT(ADDR(.rio_route) - 0) { __start_rio_route_ops = .; *(.rio_route_ops) __end_rio_route_ops = .; } __ksymtab : AT(ADDR(__ksymtab) - 0) { __start___ksymtab = .; *(__ksymtab) __stop___ksymtab = .; } __ksymtab_gpl : AT(ADDR(__ksymtab_gpl) - 0) { __start___ksymtab_gpl = .; *(__ksymtab_gpl) __stop___ksymtab_gpl = .; } __ksymtab_unused : AT(ADDR(__ksymtab_unused) - 0) { __start___ksymtab_unused = .; *(__ksymtab_unused) __stop___ksymtab_unused = .; } __ksymtab_unused_gpl : AT(ADDR(__ksymtab_unused_gpl) - 0) { __start___ksymtab_unused_gpl = .; *(__ksymtab_unused_gpl) __stop___ksymtab_unused_gpl = .; } __ksymtab_gpl_future : AT(ADDR(__ksymtab_gpl_future) - 0) { __start___ksymtab_gpl_future = .; *(__ksymtab_gpl_future) __stop___ksymtab_gpl_future = .; } __kcrctab : AT(ADDR(__kcrctab) - 0) { __start___kcrctab = .; *(__kcrctab) __stop___kcrctab = .; } __kcrctab_gpl : AT(ADDR(__kcrctab_gpl) - 0) { __start___kcrctab_gpl = .; *(__kcrctab_gpl) __stop___kcrctab_gpl = .; } __kcrctab_unused : AT(ADDR(__kcrctab_unused) - 0) { __start___kcrctab_unused = .; *(__kcrctab_unused) __stop___kcrctab_unused = .; } __kcrctab_unused_gpl : AT(ADDR(__kcrctab_unused_gpl) - 0) { __start___kcrctab_unused_gpl = .; *(__kcrctab_unused_gpl) __stop___kcrctab_unused_gpl = .; } __kcrctab_gpl_future : AT(ADDR(__kcrctab_gpl_future) - 0) { __start___kcrctab_gpl_future = .; *(__kcrctab_gpl_future) __stop___kcrctab_gpl_future = .; } __ksymtab_strings : AT(ADDR(__ksymtab_strings) - 0) { *(__ksymtab_strings) } __init_rodata : AT(ADDR(__init_rodata) - 0) { *(.ref.rodata) } __param : AT(ADDR(__param) - 0) { __start___param = .; *(__param) __stop___param = .; . = ALIGN((4096)); __end_rodata = .; } . = ALIGN((4096));

 /* writeable */
 .data : { /* Data */
  . = . + 0; /* for CONFIG_MAPPED_KERNEL */
  /*
		 * This ALIGN is needed as a workaround for a bug a
		 * gcc bug upto 4.1 which limits the maximum alignment
		 * to at most 32kB and results in the following
		 * warning:
		 *
		 *  CC      arch/mips/kernel/init_task.o
		 * arch/mips/kernel/init_task.c:30: warning: alignment
		 * of ?˜init_thread_union??is greater than maximum
		 * object file alignment.  Using 32768
		 */
  . = ALIGN(4096);
  *(.data.init_task)

  *(.data) *(.ref.data) . = ALIGN(8); __start___markers = .; *(__markers) __stop___markers = .; . = ALIGN(32); __start___tracepoints = .; *(__tracepoints) __stop___tracepoints = .; . = ALIGN(8); __start___verbose = .; *(__verbose) __stop___verbose = .;
  CONSTRUCTORS




 }
 _gp = . + 0x8000;
 .lit8 : {
  *(.lit8)
 }
 .lit4 : {
  *(.lit4)
 }
 /* We want the small data sections together, so single-instruction offsets
	   can access them all, and initialized data all before uninitialized, so
	   we can shorten the on-disk segment size.  */
 .sdata : {
  *(.sdata)
 }

 . = ALIGN(4096);
 .data_nosave : {
  __nosave_begin = .;
  *(.data.nosave)
 }
 . = ALIGN(4096);
 __nosave_end = .;

 . = ALIGN(1 << 5);
 .data.cacheline_aligned : {
  *(.data.cacheline_aligned)
 }
 _edata = .; /* End of data section */

 /* will be freed after init */
 . = ALIGN(4096); /* Init code and data */
 __init_begin = .;
 .init.text : {
  _sinittext = .;
  *(.init.text) *(.devinit.text) *(.cpuinit.text) *(.meminit.text)
  _einittext = .;
 }
 .init.data : {
  *(.init.data) *(.devinit.data) *(.devinit.rodata) *(.cpuinit.data) *(.cpuinit.rodata) *(.meminit.data) *(.meminit.rodata)
 }
 . = ALIGN(16);
 .init.setup : {
  __setup_start = .;
  *(.init.setup)
  __setup_end = .;
 }

 .initcall.init : {
  __initcall_start = .;
  *(.initcallearly.init) __early_initcall_end = .; *(.initcall0.init) *(.initcall0s.init) *(.initcall1.init) *(.initcall1s.init) *(.initcall2.init) *(.initcall2s.init) *(.initcall3.init) *(.initcall3s.init) *(.initcall4.init) *(.initcall4s.init) *(.initcall5.init) *(.initcall5s.init) *(.initcallrootfs.init) *(.initcall6.init) *(.initcall6s.init) *(.initcall7.init) *(.initcall7s.init)
  __initcall_end = .;
 }

 .con_initcall.init : {
  __con_initcall_start = .;
  *(.con_initcall.init)
  __con_initcall_end = .;
 }
 .security_initcall.init : AT(ADDR(.security_initcall.init) - 0) { __security_initcall_start = .; *(.security_initcall.init) __security_initcall_end = .; }

 /* .exit.text is discarded at runtime, not link time, to deal with
	 * references from .rodata
	 */
 .exit.text : {
  *(.exit.text) *(.devexit.text) *(.cpuexit.text) *(.memexit.text)
 }
 .exit.data : {
  *(.exit.data) *(.devexit.data) *(.devexit.rodata) *(.cpuexit.data) *(.cpuexit.rodata) *(.memexit.data) *(.memexit.rodata)
 }
 . = ALIGN(4096); .data.percpu : AT(ADDR(.data.percpu) - 0) { __per_cpu_load = .; __per_cpu_start = .; *(.data.percpu.first) *(.data.percpu.page_aligned) *(.data.percpu) *(.data.percpu.shared_aligned) __per_cpu_end = .; }
 . = ALIGN(4096);
 __init_end = .;
 /* freed after init ends here */
 __bss_start = .; /* BSS */
 .sbss : {
  *(.sbss)
  *(.scommon)
 }
 .bss : {
  *(.bss)
  *(COMMON)





 }
 __bss_stop = .;

 _end = . ;

 /* Sections to be discarded */
 /DISCARD/ : {
  *(.exitcall.exit)

  /* ABI crap starts here */
  *(.MIPS.options)
  *(.options)
  *(.pdr)
  *(.reginfo)
 }

 /* These mark the ABI of the kernel for debuggers.  */
 .mdebug.abi32 : {
  KEEP(*(.mdebug.abi32))
 }
 .mdebug.abi64 : {
  KEEP(*(.mdebug.abi64))
 }

 /* This is the MIPS specific mdebug section.  */
 .mdebug : {
  *(.mdebug)
 }

 .stab 0 : { *(.stab) } .stabstr 0 : { *(.stabstr) } .stab.excl 0 : { *(.stab.excl) } .stab.exclstr 0 : { *(.stab.exclstr) } .stab.index 0 : { *(.stab.index) } .stab.indexstr 0 : { *(.stab.indexstr) } .comment 0 : { *(.comment) }
 .debug 0 : { *(.debug) } .line 0 : { *(.line) } .debug_srcinfo 0 : { *(.debug_srcinfo) } .debug_sfnames 0 : { *(.debug_sfnames) } .debug_aranges 0 : { *(.debug_aranges) } .debug_pubnames 0 : { *(.debug_pubnames) } .debug_info 0 : { *(.debug_info .gnu.linkonce.wi.*) } .debug_abbrev 0 : { *(.debug_abbrev) } .debug_line 0 : { *(.debug_line) } .debug_frame 0 : { *(.debug_frame) } .debug_str 0 : { *(.debug_str) } .debug_loc 0 : { *(.debug_loc) } .debug_macinfo 0 : { *(.debug_macinfo) } .debug_weaknames 0 : { *(.debug_weaknames) } .debug_funcnames 0 : { *(.debug_funcnames) } .debug_typenames 0 : { *(.debug_typenames) } .debug_varnames 0 : { *(.debug_varnames) }

 /* These must appear regardless of  .  */
 .gptab.sdata : {
  *(.gptab.data)
  *(.gptab.sdata)
 }
 .gptab.sbss : {
  *(.gptab.bss)
  *(.gptab.sbss)
 }
}
